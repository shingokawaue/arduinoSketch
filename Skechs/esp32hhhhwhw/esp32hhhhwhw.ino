#include <Adafruit_GFX.h>
#include <Adafruit_SSD1306.h>
Adafruit_SSD1306 display(-1);
#if (SSD1306_LCDHEIGHT != 32 )
#error("Height incorrect, please fix Adafruit_SSD1306.h!");
#endif
#include "hhhhwhw.h"
#include "clap.h"
#include <driver/dac.h>



//---▼--------▼--------------------▼---▼------------▼---------------------▼▼---▼------------------------------------
//---▼-▼---▼-▼----▼----▼-----▼▼▼▼▼▼-----------▼------▼▼▼----------▼----------▼--▼▼--------▼▼--------------
//---▼---▼----▼-----▼-▼----------▼---▼--------▼▼▼----▼------▼-----▼▼▼▼---▼---▼▼----▼----▼----▼------------
//---▼---------▼------▼------------▼--▼-------▼---▼----▼▼▼▼▼---------▼-----▼---▼------▼---▼▼▼▼▼------------
//---▼---------▼-----▼--------▼▼▼▼▼▼▼-----▼---▼-----▼------▼--------▼-----▼---▼-----▼----▼------------------
//---▼---------▼----▼--------------▼-▼---------▼▼▼-------▼▼▼----------▼-----▼---▼------▼-----▼▼▼-------------
const int TOUCH_THRESHOLD = 20;
const uint32_t SAMPLE_DELAY_US = (uint32_t)(1000000 / 44100);
/**********************************                                     */
/*****************************************************************/
const uint8_t LED_0 = 0;
const uint8_t PLAY_PIN_L = 25;
const uint8_t PLAY_PIN_R = 26;
const uint8_t MIKE_IN = 35;
//T0 4
//T2 2



/*****************************************************************/
/* CONSTANTS                                                  */
/*****************************************************************/


//---▼---------▼-------------------------------------------------------------------------------------------
//----▼-------▼----------------▼-------▼---------------▼---------▼------▼▼--------▼▼------------------------------
//-----▼-----▼-----▼▼▼▼-----▼▼▼-----------▼▼▼----▼▼▼------▼----▼----▼-----▼---▼----------------------------
//------▼---▼-----▼-----▼-----▼---▼--▼----▼-----▼--▼----▼----▼---▼▼▼▼▼----▼▼▼------------------------------
//-------▼-▼------▼-----▼-----▼-------▼----▼-----▼--▼----▼----▼----▼---------------▼----------------------------
//--------▼---------▼▼▼--▼---▼-------▼------▼▼▼-▼--▼▼▼-----▼-----▼▼▼------▼▼▼-----------------------------

uint8_t* recordArray = new uint8_t[88200];
boolean TouchedT0 = false;
boolean TouchedT3 = false;
//------▼▼▼-------------------------------------------------------------------------------------------------
//--------▼------▼--▼▼---------▼------------------------------------------------------------------------------
//--------▼------▼▼----▼---▼▼▼▼▼▼------▼▼▼-----▼--▼▼-----▼--▼▼-----▼-----▼---▼▼▼▼-------▼--------------
//--------▼------▼------▼-------▼--------▼-----▼----▼▼----▼---▼▼----▼---▼-----▼---▼-----▼--▼▼▼▼▼-----------
//--------▼------▼------▼-------▼--------▼▼▼▼▼----▼----------▼-----------▼-----▼---▼▼▼▼-------▼--------------
//--------▼------▼------▼-------▼--------▼-----------▼----------▼-----------▼-----▼---▼------------▼---------
//------▼▼▼----.▼-----▼-------▼----------▼▼▼------▼----------▼-------------▼▼▼▼---▼------------▼--------------

void gotTouch() {
  TouchedT0 = true;
}
void gotTouch3() {
  TouchedT3 = true;
}

//-------------------------------------------------------------------------------------------------------
//-------------------------------------------------------------------------------------------------------
//                ▼▼▼       ▼▼        ▼             ▼    ▼    ▼▼▼▼
//               ▼          ▼   ▼    ▼▼▼▼          ▼    ▼    ▼     ▼
//                 ▼▼      ▼▼▼▼      ▼             ▼    ▼    ▼▼▼▼
//                    ▼     ▼           ▼             ▼   ▼     ▼
//-----------------▼▼--------▼▼--------▼--------------▼▼-------▼-----------------------------------------------
//-------------------------------------------------------------------------------------------------------

void setup() {
  Serial.begin(115200);
  pinMode(LED_0 , OUTPUT);
  pinMode(MIKE_IN , INPUT);
  touchAttachInterrupt(T0, gotTouch, TOUCH_THRESHOLD);
  touchAttachInterrupt(T3, gotTouch3, TOUCH_THRESHOLD);

    // by default, we'll generate the high voltage from the 3.3v line internally! (neat!)
  display.begin(SSD1306_SWITCHCAPVCC, 0x3C);  // initialize with the I2C addr 0x3C (for the 128x32)
  // init done` 
  display.setTextSize(1);
  display.setTextColor(WHITE);
  display.setCursor(20, 0);
  display.clearDisplay();
  display.println("Starting work!");
  display.display();
  delay(100);
}//End Of setup

//-----------------▼-----------------▼▼▼▼▼-------------▼▼▼▼▼---------▼▼▼▼▼---------------------------------
//-----------------▼----------------▼--------▼----------▼--------▼-------▼-------▼-----------------------------
//-----------------▼----------------▼--------▼----------▼--------▼-------▼-------▼------------------------------
//-----------------▼----------------▼--------▼----------▼--------▼-------▼▼▼▼▼---------------------------------
//-----------------▼----------------▼--------▼----------▼--------▼-------▼-------------------------------------
//-----------------▼▼▼▼▼▼---------▼▼▼▼▼-------------▼▼▼▼▼--------▼----------------------------------------
uint16_t loopcount = 0;
void loop() {

  if (TouchedT0 && touchRead(T0) > TOUCH_THRESHOLD ) {
    TouchedT0 = false;
    record();

  }
  if (TouchedT3 && touchRead(T3) > TOUCH_THRESHOLD ) {
    TouchedT3 = false;
    play();

  }

  loopcount++;
  if (loopcount == 1000) loopcount = 0;
  delay(100);
}// End Of loop

//-------------------------------------------------------------------------------------------------------
//--▼---------▼--------------------------------------------------------------------------------------------
//--▼▼------▼▼-------▼▼▼▼-----------▼--------▼-----------------------------▼-----▼▼▼------------------------
//--▼--▼--▼--▼-----▼-------▼-----▼▼▼▼▼▼----▼--▼▼--------▼▼▼-------▼▼▼----▼-----------------------------
//--▼----▼----▼----▼▼▼▼▼▼▼---------▼--------▼▼----▼----▼-----▼----▼---▼-----▼▼▼-------------------------
//--▼----------▼----▼-------------------▼--------▼------▼----▼-----▼----▼---▼----------▼-----------------------
//--▼----------▼------▼------▼---------▼--------▼------▼----▼-----▼----▼---▼----▼----▼------------------------
//--▼----------▼--------▼▼▼-----------▼--------▼------▼------▼▼▼-------▼▼▼-----▼▼▼-------------------------

/*****************************************************************/
/* UTILITY FUNCTIONS                                                  */
/*****************************************************************/

void play() {
  uint64_t count = 0;
  while (count < 88200) {
    dacWrite(PLAY_PIN_L, recordArray[count] );
    dacWrite(PLAY_PIN_R, recordArray[count] );
    ets_delay_us(SAMPLE_DELAY_US);//44.1kHz
    ++count;
  }
}
//void play(const unsigned char* ptr, uint32_t size) {
//  while (count < size) {
//    dacWrite(PLAY_PIN_L, ptr[count] );
//    dacWrite(PLAY_PIN_R, ptr[count] );
//    ets_delay_us(SAMPLE_DELAY_US);//44.1kHz
//    ++count;
//  }
//}
void record() {
  digitalWrite(LED_0 , HIGH);
  for (int i = 0; i < 88200; i++) {
    recordArray[i] = (uint8_t)(analogRead(A7) / 16);//analogReadは1023
    ets_delay_us(SAMPLE_DELAY_US);//44.1kHz
  }
  Serial.println("record done");
  digitalWrite(LED_0 , LOW);
}
