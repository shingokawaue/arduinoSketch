#include <Adafruit_GFX.h>
#include <Adafruit_SSD1306.h>
Adafruit_SSD1306 display(-1);
#if (SSD1306_LCDHEIGHT != 32 )
#error("Height incorrect, please fix Adafruit_SSD1306.h!");
#endif
#include "hhhhwhw.h"
#include "clap.h"
#include <driver/dac.h>



//---▼--------▼--------------------▼---▼------------▼---------------------▼▼---▼------------------------------------
//---▼-▼---▼-▼----▼----▼-----▼▼▼▼▼▼-----------▼------▼▼▼----------▼----------▼--▼▼--------▼▼--------------
//---▼---▼----▼-----▼-▼----------▼---▼--------▼▼▼----▼------▼-----▼▼▼▼---▼---▼▼----▼----▼----▼------------
//---▼---------▼------▼------------▼--▼-------▼---▼----▼▼▼▼▼---------▼-----▼---▼------▼---▼▼▼▼▼------------
//---▼---------▼-----▼--------▼▼▼▼▼▼▼-----▼---▼-----▼------▼--------▼-----▼---▼-----▼----▼------------------
//---▼---------▼----▼--------------▼-▼---------▼▼▼-------▼▼▼----------▼-----▼---▼------▼-----▼▼▼-------------

//音を鳴らす時間
#define BEAT 500
//音階名と周波数の対応
#define C4 261.6
#define C#4 277.18
#define D4 293.665
#define D#4 311.127
#define E4 329.63
#define F4 349.228
#define F#4 369.994
#define G4 391.995
#define G#4 415.305
#define A4 440
#define A#4 466.164
#define B4 493.883
#define C5 523.251

const int TOUCH_THRESHOLD = 20;
const uint32_t SAMPLE_DELAY_US = (uint32_t)(1000000 / 44100);
/**********************************                                     */
/*****************************************************************/
const uint8_t LED_0 = 0;
const uint8_t LED_23 = 23;
const uint8_t LED_19 = 19;
const uint8_t BUZZER_PIN = 18;
const uint8_t PLAY_PIN_L = 25;
const uint8_t PLAY_PIN_R = 26;
const uint8_t MIKE_IN = 35;
//T0 4
//T2 2



/*****************************************************************/
/* CONSTANTS                                                  */
/*****************************************************************/


//---▼---------▼-------------------------------------------------------------------------------------------
//----▼-------▼----------------▼-------▼---------------▼---------▼------▼▼--------▼▼------------------------------
//-----▼-----▼-----▼▼▼▼-----▼▼▼-----------▼▼▼----▼▼▼------▼----▼----▼-----▼---▼----------------------------
//------▼---▼-----▼-----▼-----▼---▼--▼----▼-----▼--▼----▼----▼---▼▼▼▼▼----▼▼▼------------------------------
//-------▼-▼------▼-----▼-----▼-------▼----▼-----▼--▼----▼----▼----▼---------------▼----------------------------
//--------▼---------▼▼▼--▼---▼-------▼------▼▼▼-▼--▼▼▼-----▼-----▼▼▼------▼▼▼-----------------------------
uint16_t loopcount = 0;
uint8_t* recordArray = new uint8_t[88200];
boolean TouchedT0 = false;
boolean TouchedT3 = false;
//------▼▼▼-------------------------------------------------------------------------------------------------
//--------▼------▼--▼▼---------▼------------------------------------------------------------------------------
//--------▼------▼▼----▼---▼▼▼▼▼▼------▼▼▼-----▼--▼▼-----▼--▼▼-----▼-----▼---▼▼▼▼-------▼--------------
//--------▼------▼------▼-------▼--------▼-----▼----▼▼----▼---▼▼----▼---▼-----▼---▼-----▼--▼▼▼▼▼-----------
//--------▼------▼------▼-------▼--------▼▼▼▼▼----▼----------▼-----------▼-----▼---▼▼▼▼-------▼--------------
//--------▼------▼------▼-------▼--------▼-----------▼----------▼-----------▼-----▼---▼------------▼---------
//------▼▼▼----.▼-----▼-------▼----------▼▼▼------▼----------▼-------------▼▼▼▼---▼------------▼--------------

void gotTouch() {
  TouchedT0 = true;
}
void gotTouch3() {
  TouchedT3 = true;
}

//-------------------------------------------------------------------------------------------------------
//-------------------------------------------------------------------------------------------------------
//                ▼▼▼       ▼▼        ▼             ▼    ▼    ▼▼▼▼
//               ▼          ▼   ▼    ▼▼▼▼          ▼    ▼    ▼     ▼
//                 ▼▼      ▼▼▼▼      ▼             ▼    ▼    ▼▼▼▼
//                    ▼     ▼           ▼             ▼   ▼     ▼
//-----------------▼▼--------▼▼--------▼--------------▼▼-------▼-----------------------------------------------
//-------------------------------------------------------------------------------------------------------

void setup() {
  Serial.begin(115200);
    ledcSetup(1,12000, 8);
  ledcAttachPin(BUZZER_PIN,1);
  pinMode(LED_0 , OUTPUT);
  pinMode(LED_23 , OUTPUT);
  pinMode(LED_19 , OUTPUT);
  //pinMode(BUZZER_PIN , OUTPUT);
  pinMode(MIKE_IN , INPUT);
  touchAttachInterrupt(T0, gotTouch, TOUCH_THRESHOLD);
  touchAttachInterrupt(T3, gotTouch3, TOUCH_THRESHOLD);

    // by default, we'll generate the high voltage from the 3.3v line internally! (neat!)
  display.begin(SSD1306_SWITCHCAPVCC, 0x3C);  // initialize with the I2C addr 0x3C (for the 128x32)
  // init done` 
  display.setTextSize(1);
  display.setTextColor(WHITE);
  display.setCursor(20, 0);
  display.clearDisplay();
  display.println("Starting work!");
  display.display();

  

  delay(100);
}//End Of setup

//-----------------▼-----------------▼▼▼▼▼-------------▼▼▼▼▼---------▼▼▼▼▼---------------------------------
//-----------------▼----------------▼--------▼----------▼--------▼-------▼-------▼-----------------------------
//-----------------▼----------------▼--------▼----------▼--------▼-------▼-------▼------------------------------
//-----------------▼----------------▼--------▼----------▼--------▼-------▼▼▼▼▼---------------------------------
//-----------------▼----------------▼--------▼----------▼--------▼-------▼-------------------------------------
//-----------------▼▼▼▼▼▼---------▼▼▼▼▼-------------▼▼▼▼▼--------▼----------------------------------------
void loop() {

  if (TouchedT0 && touchRead(T0) > TOUCH_THRESHOLD ) {
    TouchedT0 = false;
    record();

  }
  if (TouchedT3 && touchRead(T3) > TOUCH_THRESHOLD ) {
    TouchedT3 = false;
    playmusic();

  }

  loopcount++;
  if (loopcount == 1000) loopcount = 0;
  dispStatus();
  delay(100);
}// End Of loop

//-------------------------------------------------------------------------------------------------------
//--▼---------▼--------------------------------------------------------------------------------------------
//--▼▼------▼▼-------▼▼▼▼-----------▼--------▼-----------------------------▼-----▼▼▼------------------------
//--▼--▼--▼--▼-----▼-------▼-----▼▼▼▼▼▼----▼--▼▼--------▼▼▼-------▼▼▼----▼-----------------------------
//--▼----▼----▼----▼▼▼▼▼▼▼---------▼--------▼▼----▼----▼-----▼----▼---▼-----▼▼▼-------------------------
//--▼----------▼----▼-------------------▼--------▼------▼----▼-----▼----▼---▼----------▼-----------------------
//--▼----------▼------▼------▼---------▼--------▼------▼----▼-----▼----▼---▼----▼----▼--//--▼----------▼--------▼▼▼-----------▼--------▼------▼------▼▼▼-------▼▼▼-----▼▼▼-------------------------

/*****************************************************************/
/* UTILITY FUNCTIONS                                                  */
/*****************************************************************/
void dispStatus(){
    display.clearDisplay();
  display.setTextSize(1);
  display.setTextColor(BLACK, WHITE);
  display.setCursor(0, 0);
  display.print(" ToneTester ");
  display.setCursor(0, 8);
  display.setTextColor(WHITE);
  display.print("Gate_Photo:");
display.setCursor(100, 24);
display.print(loopcount);
  display.display();
}

void playmusic(){
    ledcWriteTone(1,C4);
    delay(BEAT);
    ledcWriteTone(1,D4);
    delay(BEAT);
    ledcWriteTone(1,E4);
    delay(BEAT);
    ledcWriteTone(1,F4);
    delay(BEAT);
    ledcWriteTone(1,G4);
    delay(BEAT);
    ledcWriteTone(1,A4);
    delay(BEAT);
    ledcWriteTone(1,B4);
    delay(BEAT);
    ledcWriteTone(1,C5);
    delay(BEAT);
}
void play() {
digitalWrite(LED_23,HIGH);
for(int i = 0; i < 500 ; i++){
     digitalWrite(BUZZER_PIN,HIGH);
    delay(2);//wait for 1ms
    digitalWrite(BUZZER_PIN,LOW);
    delay(2);//wait for 1ms
}
delay(1000);

digitalWrite(LED_23,LOW);
}
void record() {
  digitalWrite(LED_0 , HIGH);
digitalWrite(LED_19,HIGH);
digitalWrite(BUZZER_PIN,HIGH);
delay(1000);
digitalWrite(LED_19,LOW);
  digitalWrite(LED_0 , LOW);
  digitalWrite(BUZZER_PIN,LOW);
}
