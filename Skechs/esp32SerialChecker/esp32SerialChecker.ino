#include <MyNetSerial.h>
#include "MyToString.h"
#include <Adafruit_SSD1306.h>
Adafruit_SSD1306 display(-1);
#if (SSD1306_LCDHEIGHT != 32)
#error("Height incorrect, please fix Adafruit_SSD1306.h!");
#endif
//-------------------------------------------------------------------------------------------------------

//---▼--------▼--------------------▼---▼------------▼---------------------▼▼---▼-------------------------------
//---▼-▼---▼-▼----▼----▼-----▼▼▼▼▼▼-----------▼------▼▼▼----------▼----------▼--▼▼--------▼▼-----------
//---▼---▼----▼-----▼-▼----------▼---▼--------▼▼▼----▼------▼-----▼▼▼▼---▼---▼▼----▼----▼----▼---------
//---▼---------▼------▼------------▼--▼-------▼---▼----▼▼▼▼▼---------▼-----▼---▼------▼---▼▼▼▼▼----------
//---▼---------▼-----▼--------▼▼▼▼▼▼▼-----▼---▼-----▼------▼--------▼-----▼---▼-----▼----▼----------------
//---▼---------▼----▼--------------▼-▼---------▼▼▼-------▼▼▼----------▼-----▼---▼------▼-----▼▼▼---------
/*****************************************************************/
/* CONSTANTS                                                  */
/*****************************************************************/

/*****************************************************************/
/* PINS                                                  */
/*****************************************************************/

const uint8_t RX2 = 16;
const uint8_t TX2 = 17;

//---▼---------▼-------------------------------------------------------------------------------------------
//----▼-------▼----------------▼-------▼---------------▼---------▼------▼▼--------▼▼--------------------
//-----▼-----▼-----▼▼▼▼-----▼▼▼-----------▼▼▼----▼▼▼------▼----▼----▼-----▼---▼-------------------
//------▼---▼-----▼-----▼-----▼---▼--▼----▼-----▼--▼----▼----▼---▼▼▼▼▼----▼▼▼--------------------
//-------▼-▼------▼-----▼-----▼-------▼----▼-----▼--▼----▼----▼----▼---------------▼------------------
//--------▼---------▼▼▼--▼---▼-------▼------▼▼▼-▼--▼▼▼-----▼-----▼▼▼------▼▼▼---------------------

#include "HardwareSerial.h"
HardwareSerial MySerial(2);//UART2 ( デフォルト RX=GPIO16, TX=GPIO17 )
MyNetSerial mynet(MCID_ESP32_C);
char readc;

uint16_t loopcount = 0;
//------▼▼▼-------------------------------------------------------------------------------------------------
//--------▼------▼--▼▼---------▼------------------------------------------------------------------------------
//--------▼------▼▼----▼---▼▼▼▼▼▼------▼▼▼-----▼--▼▼-----▼--▼▼-----▼-----▼---▼▼▼▼-------▼---------
//--------▼------▼------▼-------▼--------▼-----▼----▼▼----▼---▼▼----▼---▼-----▼---▼-----▼--▼▼▼▼▼------
//--------▼------▼------▼-------▼--------▼▼▼▼▼----▼----------▼-----------▼-----▼---▼▼▼▼-------▼---------
//--------▼------▼------▼-------▼--------▼-----------▼----------▼-----------▼-----▼---▼------------▼---------
//------▼▼▼----.▼-----▼-------▼----------▼▼▼------▼----------▼-------------▼▼▼▼---▼------------▼---------


//-------------------------------------------------------------------------------------------------------
//-------------------------------------------------------------------------------------------------------
//                ▼▼▼       ▼▼        ▼             ▼    ▼    ▼▼▼▼
//               ▼          ▼   ▼    ▼▼▼▼          ▼    ▼    ▼     ▼
//                 ▼▼      ▼▼▼▼      ▼             ▼    ▼    ▼▼▼▼
//                    ▼     ▼           ▼             ▼   ▼     ▼
//-----------------▼▼--------▼▼--------▼--------------▼▼-------▼-----------------------------------------------
//-------------------------------------------------------------------------------------------------------

void setup() {

  Serial.begin(115200);
  MySerial.begin(MyNetSerial::BPS , SERIAL_8N1, RX2, TX2); //UART2 ( デフォルト RX=GPIO16, TX=GPIO17 )
  mynet.beginPort(MySerial, MCID_MASTER_RPI);
  // by default, we'll generate the high voltage from the 3.3v line internally! (neat!)
  display.begin(SSD1306_SWITCHCAPVCC, 0x3C);  // initialize with the I2C addr 0x3C (for the 128x64)
  // init done
  delay(100);


}//End Of setup
//-----------------▼-----------------▼▼▼▼▼-------------▼▼▼▼▼---------▼▼▼▼▼------------------------------
//-----------------▼----------------▼--------▼----------▼--------▼-------▼-------▼-----------------------------
//-----------------▼----------------▼--------▼----------▼--------▼-------▼-------▼------------------------------
//-----------------▼----------------▼--------▼----------▼--------▼-------▼▼▼▼▼---------------------
//-----------------▼----------------▼--------▼----------▼--------▼-------▼-------------------------------------
//-----------------▼▼▼▼▼▼---------▼▼▼▼▼-------------▼▼▼▼▼--------▼------------------------------
void loop() {

if( (loopcount % 50) == 0) {
  //MySerial.print('a');
  mynet.send(MCID_MASTER_RPI, SDPP_PERIODIC_CONFIRMATION);
}

  if (MySerial.available()) {
    //readc = MySerial.read();
    mynet.receive(MySerial);
  }
processMyData();

  loopcount++;
  if (loopcount == 1000) loopcount = 0;
  dispStatus();
  delay(10);
}//End Of loop

//-------------------------------------------------------------------------------------------------------
//--▼---------▼--------------------------------------------------------------------------------------------
//--▼▼------▼▼-------▼▼▼▼-----------▼--------▼-----------------------------▼-----▼▼▼--------------------
//--▼--▼--▼--▼-----▼-------▼-----▼▼▼▼▼▼----▼--▼▼--------▼▼▼-------▼▼▼----▼------------------------
//--▼----▼----▼----▼▼▼▼▼▼▼---------▼--------▼▼----▼----▼-----▼----▼---▼-----▼▼▼-------------------
//--▼----------▼----▼-------------------▼--------▼------▼----▼-----▼----▼---▼----------▼-----------------
//--▼----------▼------▼------▼---------▼--------▼------▼----▼-----▼----▼---▼----▼----▼-------------------
//--▼----------▼--------▼▼▼-----------▼--------▼------▼------▼▼▼-------▼▼▼-----▼▼▼--------------------


void dispStatus() {
  display.clearDisplay();
  display.setTextColor(BLACK, WHITE);
  display.setTextSize(1);
  display.setCursor(0, 0);
  display.print(" ESP32_SerialChecker ");
  display.setTextColor(WHITE);
  display.setCursor(0, 8);
  display.print("read char = ");
  display.print(readc);
  display.setCursor(100,24);
  display.print(loopcount);
  display.display();
}

void processMyData() {
  SerialData* sd = mynet.containedPick();

  while ( sd != NULL) {

    switch (sd->receiver())
    { //受信者MCIDで分岐
      case MCID_ESP32_C:
        dataToMe(sd);
        break;
    }
    sd = mynet.containedPick();
  }//while

}



void dataToMe(SerialData* sd)//基本MASTER_MEGAからしか来ない前提
{
  switch (sd->pid()) {
    case PID_LIGHTSOFFTIME:
//      {
//        switch (sd->sdpp()) {
//          case SDPP_TIME_REPORT:
//            lightsOffTime = sd->int16();
//            lightsOffClock.showNumberDecEx(lightsOffTime , 0b01000000, true);
//            break;
//        }//switch
//      }//case PID_MASTER_LIGHTSOFFTIME:
//      break;
//    case PID_TIME: { //sdpp_time_requestしか来ない前提
//        uint32_t ut = getUnixTimeFromRaspPi();
//        if (ut != 0)
//          mynet.sendUT(ut , MCID_MASTER_MEGA , SDPP_TIME_REPORT , PID_TIME);
//      }
      break;
    case PID_DB_WEATHER:
//      {
//        weatherJsonBuf = sd->charHeap();
//        insertToMynetWeather();
//      }
      break;
    case PID_DOOR_INSIDE_PIR:
//      {
//        if (WiFi.status() != WL_CONNECTED) return;
//        http.begin("http://192.168.0.150/BUZZER");
//        int httpCode = http.GET();
//        if (httpCode == HTTP_CODE_OK) {
//          httpGetString = http.getString();
//        } else {
//          httpGetString = "";
//        }
//                http.begin("http://192.168.0.149/BUZZER");
//        httpCode = http.GET();
//        if (httpCode == HTTP_CODE_OK) {
//          httpGetString = http.getString();
//        } else {
//          httpGetString = "";
//        }
//      }//PID_DOOR_INSIDE_PIR:
      break;
    case PID_NONE:
      {
        switch (sd->sdpp()) {
          case SDPP_PERIODIC_CONFIRMATION: //定期確認
            { //switchでネストするときはcaseにカッコが必要
              readc = 'o';
              break;
            }
            //        case SDPP_PERIODIC_CONFIRMATION_BACK: //定期確認返し
            //          //なんもせん
            //          break;
        }//switch
      }//case PID_NONE:
      break;
  }//switch (mydata[id].pid)

}
